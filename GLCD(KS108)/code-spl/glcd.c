#include "stm32f10x.h"
#include "delay.h"
#include "glcd.h"

int idelay;
#define DELAY for(idelay =  0 ; idelay < 1000 ; idelay++);


//GLCD FontName : Tahoma33x49
//GLCD FontSize : 33 x 49   180 rotate   font 48 thomas

const unsigned short Tahoma33x49[] = {
        0x20, 0x00, 0x00, 0x00, 0x00, 0x00, 0x00, 0x00, 0x00, 0x00, 0x00, 0x00,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 0x00,  // Code for char 0
        0x1A, 0x00, 0x00, 0x00, 0x00, 0x00, 0x00, 0x00, 0x00, 0x00, 0x00, 0x00,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 0x00,  // Code for char 1
        0x1F, 0x00, 0x00, 0x00, 0x00, 0x00, 0x00, 0x00, 0x00, 0x00, 0x00, 0x00,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 0x00,  // Code for char 2
        0x1F, 0x00, 0x00, 0x00, 0x00, 0x00, 0x00, 0x00, 0x00, 0x00, 0x00, 0x00,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 0x00,  // Code for char 3
        0x21, 0x00, 0x00, 0x3E, 0x00, 0x00, 0x00, 0x00, 0x00, 0x00, 0x3E, 0x00,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 0x00,  // Code for char 4
        0x1E, 0x00, 0x00, 0x00, 0x00, 0x00, 0x00, 0x00, 0x00, 0x00, 0x00, 0x00,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 0x00,  // Code for char 5
        0x1F, 0x00, 0x00, 0x00, 0x00, 0x00, 0x00, 0x00, 0x00, 0xF0, 0x1F, 0x00,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 0x00,  // Code for char 6
        0x1F, 0x00, 0x00, 0x00, 0x00, 0x00, 0x00, 0x00, 0x00, 0x00, 0x00, 0x00,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 0x00,  // Code for char 7
        0x1F, 0x00, 0x00, 0x00, 0x00, 0x00, 0x00, 0x00, 0x00, 0xFC, 0x03, 0x00,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 0x00,  // Code for char 8
        0x20, 0x00, 0x00, 0x00, 0x00, 0x00, 0x00, 0x00, 0x00, 0x00, 0x00, 0x00,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 0x00, 0x00   // Code for char 9
        };

unsigned char screen_x = 0, screen_y = 0;
unsigned char CurrentColumn,DisplayData[128][8];


static void DATAPORT(char val)
{
unsigned short datar;	
	  datar = GPIO_ReadOutputData(GPIOE) & 0xff00;
		GPIO_Write(GPIOE, val | datar);
}


//-------------------------------------------------------------------------------------------------
//
//-------------------------------------------------------------------------------------------------
void GLCD_DisableController(unsigned char controller)
{
switch(controller){
	case 0 : GPIO_SetBits(GLCD_CS2_PORT, GLCD_CS2_PIN); break;
	case 1 : GPIO_SetBits(GLCD_CS1_PORT, GLCD_CS1_PIN); break;
	}
}

//-------------------------------------------------------------------------------------------------
//
//-------------------------------------------------------------------------------------------------
void GLCD_EnableController(unsigned char controller)
{
    switch(controller)
    {
        case 0 : GPIO_ResetBits(GLCD_CS2_PORT, GLCD_CS2_PIN); break;
        case 1 : GPIO_ResetBits(GLCD_CS1_PORT, GLCD_CS1_PIN); break;
    }
}
//-------------------------------------------------------------------------------------------------
//
//-------------------------------------------------------------------------------------------------
void GLCD_WriteCommand(unsigned char commandToWrite, unsigned char controller)
{
unsigned int command;
DELAY

GPIO_ResetBits(GLCD_RS_PORT, GLCD_RS_PIN);//rs
GPIO_ResetBits(GLCD_RW_PORT, GLCD_RW_PIN);//rw
GLCD_EnableController(controller);
command=commandToWrite;
DATAPORT(command);	
GPIO_SetBits(GLCD_EN_PORT, GLCD_EN_PIN);	
DELAY	
GPIO_ResetBits(GLCD_EN_PORT, GLCD_EN_PIN);	
GLCD_DisableController(controller);
}
//-------------------------------------
void GLCD_WriteData(unsigned char dataToWrite)
{
unsigned int byte;
DELAY 	
GPIO_ResetBits(GLCD_RW_PORT, GLCD_RW_PIN);// rw
GPIO_SetBits(GLCD_RS_PORT, GLCD_RS_PIN);	//rs
byte = dataToWrite;
DATAPORT(byte);	
GLCD_EnableController(screen_x / 64);
GPIO_SetBits(GLCD_EN_PORT, GLCD_EN_PIN);	
DELAY	
GPIO_ResetBits(GLCD_EN_PORT, GLCD_EN_PIN);
GLCD_DisableController(screen_x / 64);
screen_x++;
}
//-----------------------------------------
void GLCD_GoTo(unsigned char x, unsigned char y)
{
unsigned char i;
screen_x = x;
screen_y = y;

for(i = 0; i < KS0108_SCREEN_WIDTH / 64; i++)
{
    GLCD_WriteCommand(DISPLAY_SET_Y | 0,i);
    GLCD_WriteCommand(DISPLAY_SET_X | y,i);
    GLCD_WriteCommand(DISPLAY_START_LINE | 0,i);
}
GLCD_WriteCommand(DISPLAY_SET_Y | (x % 64), (x / 64));
GLCD_WriteCommand(DISPLAY_SET_X | y, (x / 64));
}
//---------------------------------------------
void putpixel(unsigned int x, unsigned int y)
{
    unsigned char tmp=0;
	  tmp=DisplayData[x][ y / 8 ];
    GLCD_GoTo(x, (y / 8));
    tmp |= (1 << (y % 8));
    GLCD_WriteData(tmp);
}

//---------------------------------------------
void GLCD_ClearScreen(void)
{
unsigned char i, j;
for(j = 0; j < KS0108_SCREEN_HEIGHT/8; j++)
  {
    GLCD_GoTo(0,j);
    for(i = 0; i < KS0108_SCREEN_WIDTH; i++)
        GLCD_WriteData(0x00);
  }
}
//---------------------------------------------
unsigned char GLCD_ReadByteFromROMMemory(char * ptr)
{
return *(ptr);
}





//---------------------------------------------
void SetPage(unsigned char x){
	GLCD_WriteCommand(DISPLAY_SET_X | x, 0);
	GLCD_WriteCommand(DISPLAY_SET_X | x, 1);
}
//---------------------------------------------
void SetColumn(unsigned char y){
CurrentColumn = y;
if (y < 64){
	GLCD_WriteCommand(DISPLAY_SET_Y | (y&63), 0);
	GLCD_WriteCommand(DISPLAY_SET_Y | 0, 1);
	 }
else{
	GLCD_WriteCommand(DISPLAY_SET_Y | 63, 0);
	GLCD_WriteCommand(DISPLAY_SET_Y | ((y-64)&63), 1);
	 }
}
//---------------------------------------------
void glcd_init() {
	
	unsigned char i;
	/////// Initialize ///////////////
  GPIO_InitTypeDef GPIO_InitStructure;
  RCC_APB2PeriphClockCmd( RCC_APB2Periph_GPIOE , ENABLE);
	//GPIO_PinRemapConfig(GPIO_Remap_SWJ_Disable,ENABLE);
	/*DATA*/
	GPIO_InitStructure.GPIO_Pin = GPIO_Pin_0|GPIO_Pin_1|GPIO_Pin_2|GPIO_Pin_3|GPIO_Pin_4|GPIO_Pin_5|GPIO_Pin_6|GPIO_Pin_7;//GPIO_Pin_All;	
	GPIO_InitStructure.GPIO_Speed =GPIO_Speed_2MHz;
	GPIO_InitStructure.GPIO_Mode = GPIO_Mode_Out_PP;	
	GPIO_Init(GPIOE, &GPIO_InitStructure);	
	
	//CS1 and CS2 and Reset
	GPIO_InitStructure.GPIO_Pin = GLCD_CS1_PIN|GLCD_CS2_PIN|GLCD_RST_PIN|GLCD_EN_PIN;
	//GPIO_InitStructure.GPIO_Speed = GPIO_Speed_50MHz;
	GPIO_InitStructure.GPIO_Speed =GPIO_Speed_2MHz;
	GPIO_InitStructure.GPIO_Mode = GPIO_Mode_Out_PP;	
	GPIO_Init(GPIOE, &GPIO_InitStructure);	
	
 /*RS  and EL and RW*/
	GPIO_InitStructure.GPIO_Pin = GLCD_RS_PIN | GLCD_RW_PIN	 ;	
	//GPIO_InitStructure.GPIO_Speed = GPIO_Speed_50MHz;
	GPIO_InitStructure.GPIO_Speed =GPIO_Speed_2MHz;
	GPIO_InitStructure.GPIO_Mode = GPIO_Mode_Out_PP;		
	GPIO_Init(GPIOE, &GPIO_InitStructure);	
	

	GPIO_SetBits(GLCD_CS2_PORT, GLCD_CS2_PIN);

	GPIO_SetBits(GLCD_RST_PORT,GLCD_RST_PIN);

	
		for(i = 0; i < 3; i++)
			GLCD_WriteCommand((	DISPLAY_ON_CMD | ON	), i);
}

 /*   function font for one number 0 to 9 */
void Number_font(unsigned char x,unsigned char y,int Num)
{
		int i,j;
	  int n=0;
		int stop;
		int start=0;

		
						start=start+(Num*232);
						stop=start+33;	
							for( i = start ; i <stop ; i++ )
								{
									GLCD_WriteData(Tahoma33x49[i+n]);
										for( j=1 ;j<7 ;j++)
									 {
									GLCD_GoTo(x+i-start,y+j);
									GLCD_WriteData(Tahoma33x49[i+n+1]);
									n=n+1;
									}
								}
			
}

//---------------------------------------------
void GLCD_Line(unsigned int X1,unsigned int Y1,unsigned int X2,unsigned int Y2)
{
int CurrentX, CurrentY, Xinc, Yinc, 
    Dx, Dy, TwoDx, TwoDy, 
	TwoDxAccumulatedError, TwoDyAccumulatedError;

Dx = (X2-X1); // obliczenie sk³adowej poziomej
Dy = (Y2-Y1); // obliczenie sk³adowej pionowej

TwoDx = Dx + Dx; // podwojona sk³adowa pozioma
TwoDy = Dy + Dy; // podwojona sk³adowa pionowa

CurrentX = X1; // zaczynamy od X1
CurrentY = Y1; // oraz Y1

Xinc = 1; // ustalamy krok zwiêkszania pozycji w poziomie 
Yinc = 1; // ustalamy krok zwiêkszania pozycji w pionie

if(Dx < 0) // jesli sk³adowa pozioma jest ujemna 
  {
  Xinc = -1; // to bêdziemy siê "cofa?" (krok ujemny)
  Dx = -Dx;  // zmieniamy znak sk³adowej na dodatni
  TwoDx = -TwoDx; // jak r?wnie? podwojonej sk³adowej
  }

if (Dy < 0) // jeœli sk³adowa pionowa jest ujemna
  {
  Yinc = -1; // to bêdziemy siê "cofa?" (krok ujemny)
  Dy = -Dy; // zmieniamy znak sk³adowej na dodatki
  TwoDy = -TwoDy; // jak r?wniez podwojonej sk³adowej
  }
	
	
putpixel(X1,Y1); // stawiamy pierwszy krok (zapalamy pierwszy piksel)

if ((Dx != 0) || (Dy != 0)) // sprawdzamy czy linia sk³ada siê z wiêcej ni? jednego punktu ;)
  {
  // sprawdzamy czy sk³adowa pionowa jest mniejsza lub r?wna sk³adowej poziomej
  if (Dy <= Dx) // jeœli tak, to idziemy "po iksach"
    { 
    TwoDxAccumulatedError = 0; // zerujemy zmienn¹ 
    do // ruszamy w drogê
	  {
      CurrentX += Xinc; // do aktualnej pozycji dodajemy krok 
      TwoDxAccumulatedError += TwoDy; // a tu dodajemy podwojon¹ sk³adow¹ pionow¹
      if(TwoDxAccumulatedError > Dx)  // jeœli TwoDxAccumulatedError jest wiêkszy od Dx
        {
        CurrentY += Yinc; // zwiêkszamy aktualn¹ pozycjê w pionie
        TwoDxAccumulatedError -= TwoDx; // i odejmujemy TwoDx
        }
       putpixel(CurrentX,CurrentY);// stawiamy nastêpny krok (zapalamy piksel)
       }while (CurrentX != X2); // idziemy tak d³ugo, a? osi¹gniemy punkt docelowy
     }
   else // w przeciwnym razie idziemy "po igrekach" 
      {
      TwoDyAccumulatedError = 0; 
      do 
	    {
        CurrentY += Yinc; 
        TwoDyAccumulatedError += TwoDx;
        if(TwoDyAccumulatedError>Dy) 
          {
          CurrentX += Xinc;
          TwoDyAccumulatedError -= TwoDy;
          }
         putpixel(CurrentX,CurrentY); 
         }while (CurrentY != Y2);
    }
  }
}
//